## boards/shields/record_alice/Kconfig.defconfig
```kconfig
# Copyright (c) 2021 The ZMK Contributors
# SPDX-License-Identifier: MIT

if SHIELD_RECORD_ALICE

config ZMK_KEYBOARD_NAME
    default "Record Alice"

endif
```

## boards/shields/splint/Kconfig.defconfig
```kconfig
# Copyright (c) 2021 The ZMK Contributors
# SPDX-License-Identifier: MIT

if SHIELD_SPLINT_LEFT

config ZMK_KEYBOARD_NAME
    default "Splint"

config ZMK_SPLIT_ROLE_CENTRAL
    default y

config SPLINT_STATUS_LED
    bool "Enable indicator"
    default y

endif

if SHIELD_SPLINT_LEFT || SHIELD_SPLINT_RIGHT

config ZMK_SPLIT
    default y
    
config ZMK_SLEEP
    default y

config ZMK_PM_SOFT_OFF
    default y

config ZMK_KSCAN_DEBOUNCE_PRESS_MS
    default 0

config ZMK_POINTING
    default y

endif
```

## boards/shields/splint/Kconfig.shield
```kconfig
# Copyright (c) 2021 The ZMK Contributors
# SPDX-License-Identifier: MIT

config SHIELD_SPLINT_LEFT
    def_bool $(shields_list_contains,splint_left)

config SHIELD_SPLINT_RIGHT
    def_bool $(shields_list_contains,splint_right)
```
