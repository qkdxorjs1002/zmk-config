#include "splint.dtsi"

&default_transform {
    col-offset = <8>;
};

&default_kscan {
    col-gpios = 
        <&gpio1 15  GPIO_ACTIVE_HIGH>,
        <&gpio1 13  GPIO_ACTIVE_HIGH>,
        <&gpio1 11  GPIO_ACTIVE_HIGH>,
        <&gpio0 10  GPIO_ACTIVE_HIGH>,
        <&gpio0 9   GPIO_ACTIVE_HIGH>,
        <&gpio0 17  GPIO_ACTIVE_HIGH>,
        <&gpio0 20  GPIO_ACTIVE_HIGH>,
        <&gpio0 22  GPIO_ACTIVE_HIGH>;

    row-gpios = 
        <&gpio0 24  (GPIO_ACTIVE_HIGH | GPIO_PULL_DOWN)>,
        <&gpio1 0   (GPIO_ACTIVE_HIGH | GPIO_PULL_DOWN)>,
        <&gpio0 11  (GPIO_ACTIVE_HIGH | GPIO_PULL_DOWN)>,
        <&gpio1 4   (GPIO_ACTIVE_HIGH | GPIO_PULL_DOWN)>,
        <&gpio1 6   (GPIO_ACTIVE_HIGH | GPIO_PULL_DOWN)>;
};
